## quirky/buildarm64/conf/bblayers.conf
```bitbake
# LAYER_CONF_VERSION is increased each time build/conf/bblayers.conf
# changes incompatibly
LCONF_VERSION = "7"

BBPATH = "${TOPDIR}"
BBFILES ?= ""

BBLAYERS ?= " \
  /mnt/sdc1/projects/oe/oe-quirky/meta \
  /mnt/sdc1/projects/oe/oe-quirky/meta-oe \
  /mnt/sdc1/projects/oe/oe-quirky/meta-python \
  /mnt/sdc1/projects/oe/oe-quirky/meta-perl \
  /mnt/sdc1/projects/oe/oe-quirky/meta-filesystems \
  /mnt/sdc1/projects/oe/oe-quirky/meta-networking \
  /mnt/sdc1/projects/oe/oe-quirky/meta-webserver \
  /mnt/sdc1/projects/oe/oe-quirky/meta-gnome \
  /mnt/sdc1/projects/oe/oe-quirky/meta-multimedia \
  /mnt/sdc1/projects/oe/oe-quirky/meta-browser \
  /mnt/sdc1/projects/oe/oe-quirky/meta-office \
  /mnt/sdc1/projects/oe/oe-quirky/meta-quirky \
  "
```

## quirky/meta-quirky/conf/distro/quirky.conf
```bitbake
###CURRENTLY NOT USING THIS, SEE local.conf###

# ref: meta/conf/distro/defaultsetup.conf
#require conf/distro/defaultsetup.conf
# ...no, "bitbake-layers show-layers" reports a conflict, this file already included.

DISTRO = "quirky"
DISTRO_NAME = "Quirky Pyro64"
DISTRO_VERSION = "0.1"
MAINTAINER = "BK bkauler@gmail.com"

PACKAGE_CLASSES ?= "package_deb"

# ref: meta/conf/distro/include/default-distrovars.inc
# ref: http://www.yoctoproject.org/docs/current/ref-manual/ref-manual.html#ref-features-machine
DISTRO_FEATURES += "nfs opengl ppp smbfs"
```

## quirky/meta-quirky/conf/layer.conf
```bitbake
# BK 170430

# We have a conf and classes directory, append to BBPATH
BBPATH .= ":${LAYERDIR}"

# We have a recipes directory, add to BBFILES
BBFILES += "${LAYERDIR}/recipes-*/*/*.bb ${LAYERDIR}/recipes-*/*/*.bbappend"

BBFILE_COLLECTIONS += "quirky"
BBFILE_PATTERN_quirky := "^${LAYERDIR}/"

# Define the priority for recipes (.bb files) from this layer,
# choosing carefully how this layer interacts with all of the
# other layers.
BBFILE_PRIORITY_quirky = "8"

# This should only be incremented on significant changes that will
# cause compatibility issues with other layers
LAYERVERSION_quirky = "1"

LAYERDEPENDS_quirky = "core"
```

## quirky/meta-quirky/conf/machine/include/tune-cortexa53.inc
```bitbake
DEFAULTTUNE ?= "cortexa53-32"

require conf/machine/include/arm/arch-armv8.inc

TUNEVALID[cortexa53] = "Enable Cortex-A53 specific processor optimizations"
TUNE_CCARGS .= "${@bb.utils.contains('TUNE_FEATURES', 'cortexa53', ' -mcpu=cortex-a53 ', '',d)}"

# Extra tune selections
AVAILTUNES += "cortexa53-32"
ARMPKGARCH_tune-cortexa53-32 ?= "cortexa53"
TUNE_FEATURES_tune-cortexa53-32 = "${TUNE_FEATURES_tune-armv8-neon-crc} cortexa53"
BASE_LIB_tune-cortexa53-32 = "lib"
TUNE_PKGARCH_tune-cortexa53-32 = "cortexa53-32"
PACKAGE_EXTRA_ARCHS_tune-cortexa53-32 = "${PACKAGE_EXTRA_ARCHS_tune-armv8-neon-crc} cortexa53-32 cortexa53-neon-fp-armv8"

AVAILTUNES += "cortexa53crypto-32"
ARMPKGARCH_tune-cortexa53crypto-32 ?= "cortexa53"
TUNE_FEATURES_tune-cortexa53crypto-32 = "${TUNE_FEATURES_tune-armv8-neon-crypto-crc} cortexa53"
BASE_LIB_tune-cortexa53crypto-32 = "lib"
TUNE_PKGARCH_tune-cortexa53crypto-32 = "cortexa53crypto-32"
PACKAGE_EXTRA_ARCHS_tune-cortexa53crypto-32 = "${PACKAGE_EXTRA_ARCHS_tune-armv8-neon-crypto-crc} cortexa53-32 cortexa53-crypto-neon-fp-armv8"

AVAILTUNES += "cortexa53hf-32"
ARMPKGARCH_tune-cortexa53hf-32 ?= "cortexa53"
TUNE_FEATURES_tune-cortexa53hf-32 = "${TUNE_FEATURES_tune-armv8hf-neon-crc} cortexa53"
BASE_LIB_tune-cortexa53hf-32 = "lib"
TUNE_PKGARCH_tune-cortexa53hf-32 = "cortexa53hf-32"
PACKAGE_EXTRA_ARCHS_tune-cortexa53hf-32 = "${PACKAGE_EXTRA_ARCHS_tune-armv8hf-neon-crc} cortexa53hf-32 cortexa53hf-neon-fp-armv8"

AVAILTUNES += "cortexa53hfcrypto-32"
ARMPKGARCH_tune-cortexa53hfcrypto-32 ?= "cortexa53"
TUNE_FEATURES_tune-cortexa53hfcrypto-32 = "${TUNE_FEATURES_tune-armv8hf-neon-crypto-crc} cortexa53"
BASE_LIB_tune-cortexa53hfcrypto-32 = "lib"
TUNE_PKGARCH_tune-cortexa53hfcrypto-32 = "cortexa53hfcrypto-32"
PACKAGE_EXTRA_ARCHS_tune-cortexa53hfcrypto-32 = "${PACKAGE_EXTRA_ARCHS_tune-armv8hf-neon-crypto-crc} cortexa53hf-32 cortexa53hf-crypto-neon-fp-armv8"

AVAILTUNES += "cortexa53-64"
ARMPKGARCH_tune-cortexa53-64 ?= "cortexa53"
TUNE_FEATURES_tune-cortexa53-64 = "${TUNE_FEATURES_tune-aarch64} cortexa53"
BASE_LIB_tune-cortexa53-64 = "lib64"
TUNE_PKGARCH_tune-cortexa53-64 = "cortexa53-64"
PACKAGE_EXTRA_ARCHS_tune-cortexa53-64 = "${PACKAGE_EXTRA_ARCHS_tune-aarch64} cortexa53-64"
```

## quirky/meta-quirky/conf/machine/include/tune-i686.inc
```bitbake
DEFAULTTUNE ?= "i686"

require arch-x86.inc

# Extra tune features
TUNEVALID[i686] = "Enable i686 specific processor optimizations"
TUNE_CCARGS .= "${@bb.utils.contains('TUNE_FEATURES', 'i686', ' -march=i686', '', d)}"

# Extra tune selections
AVAILTUNES += "i686"
TUNE_FEATURES_tune-i686 = "${TUNE_FEATURES_tune-x86} i686"
BASE_LIB_tune-i686 = "lib"
TUNE_PKGARCH_tune-i686 = "i686"
PACKAGE_EXTRA_ARCHS_tune-i686 = "${PACKAGE_EXTRA_ARCHS_tune-x86} i686"
```

## quirky/meta-quirky/conf/machine/include/tune-nocona.inc
```bitbake
# Settings for the GCC(1) cpu-type "nocona":
#
#      Intel Nocona CPU with 64-bit extensions, MMX, SSE, SSE2, SSE3
#      instruction set support.
#
# This tune is recommended for Nocona 64-bit CPU (2005) and later.
# Note, this is before core2, and lacks ssse3.
# Note, explicitly disabling sse3, with -mno-sse3
#
DEFAULTTUNE ?= "nocona-64"

# Set x86 target arch to i686, so that glibc enables SSE optimised memcpy, etc.
X86ARCH32 ?= "i686"

# Include the previous tune to pull in PACKAGE_EXTRA_ARCHS
require conf/machine/include/tune-i586.inc

# Extra tune features
TUNEVALID[nocona] = "Enable nocona specific processor optimizations"
TUNE_CCARGS .= "${@bb.utils.contains('TUNE_FEATURES', 'nocona', ' -march=nocona -mtune=nocona -mno-sse3 -mfpmath=sse', '', d)}"

# Extra tune selections

AVAILTUNES += "nocona-64"
TUNE_FEATURES_tune-nocona-64 = "${TUNE_FEATURES_tune-x86-64} nocona"
BASE_LIB_tune-nocona-64 = "lib64"
TUNE_PKGARCH_tune-nocona-64 = "nocona-64"
PACKAGE_EXTRA_ARCHS_tune-nocona-64 = "${PACKAGE_EXTRA_ARCHS_tune-x86-64} nocona-64"

AVAILTUNES += "nocona-64-x32"
TUNE_FEATURES_tune-nocona-64-x32 = "${TUNE_FEATURES_tune-x86-64-x32} nocona"
BASE_LIB_tune-nocona-64-x32 = "libx32"
TUNE_PKGARCH_tune-nocona-64-x32 = "nocona-64-x32"
PACKAGE_EXTRA_ARCHS_tune-nocona-64-x32 = "${PACKAGE_EXTRA_ARCHS_tune-x86-64-x32} nocona-64-x32"
```

## quirky/meta-quirky/conf/machine/pcx86.conf
```bitbake
# ref: meta-yocto-bsp/conf/machine/include/genericx86-common.inc
# ref: meta/conf/machine/include/x86-base.inc, tune-core2.inc

DEFAULTTUNE ?= "i686"
require include/tune-i686.inc

require include/x86-base.inc

#above include provides these variables:
PREFERRED_PROVIDER_virtual/xserver ?= "xserver-xorg"
XSERVER ?= "${XSERVER_X86_BASE} \
            ${XSERVER_X86_EXT} \
            ${XSERVER_X86_I915} \
            ${XSERVER_X86_I965} \
            ${XSERVER_X86_FBDEV} \
            ${XSERVER_X86_VESA} \
            ${XSERVER_X86_MODESETTING} \
           "

MACHINE_FEATURES += "wifi efi pcbios bluetooth rtc vfat touchscreen"

MACHINE_EXTRA_RRECOMMENDS += "linux-firmware eee-acpi-scripts"

GLIBC_ADDONS = "nptl"

SERIAL_CONSOLES_CHECK = "ttyS0"

#
PREFERRED_VERSION_linux-yocto ?= "4.10%"

IMAGE_FSTYPES += "tar.gz"
```

## quirky/meta-quirky/conf/machine/qemuarm64.conf
```bitbake
#@TYPE: Machine
#@NAME: generic armv8 machine
#@DESCRIPTION: Machine configuration for running a generic armv8

#TUNE_FEATURES_tune-aarch64 = "aarch64 fp-armv8 neon"
#DEFAULTTUNE = "aarch64 fp-armv8 neon"

DEFAULTTUNE ?= "aarch64"

require conf/machine/include/arm/arch-armv8.inc
require conf/machine/include/qemu.inc

#TUNE_CCARGS .= "${@bb.utils.contains('TUNE_FEATURES', 'aarch64', ' -march=armv8-a -mfloat-abi=hard -mfpu=neon-fp-armv8', '', d)}"
TUNE_CCARGS .= " -march=armv8-a -mfloat-abi=hard -mfpu=neon-fp-armv8"

KERNEL_IMAGETYPE = "Image"

SERIAL_CONSOLES ?= "38400;ttyAMA0 38400;hvc0"

MACHINE_FEATURES += "wifi bluetooth rtc vfat touchscreen"
MACHINE_EXTRA_RRECOMMENDS += "linux-firmware"
GLIBC_ADDONS = "nptl"

# For runqemu
QB_SYSTEM_NAME = "qemu-system-aarch64"
QB_MEM = "-m 512"
QB_MACHINE = "-machine virt"
QB_CPU = "-cpu cortex-a57"
QB_KERNEL_CMDLINE_APPEND = "console=ttyAMA0,38400"
# Add the 'virtio-rng-pci' device otherwise the guest may run out of entropy
QB_OPT_APPEND = "-show-cursor -device virtio-rng-pci -monitor null"
QB_TAP_OPT = "-netdev tap,id=net0,ifname=@TAP@,script=no,downscript=no"
QB_NETWORK_DEVICE = "-device virtio-net-device,netdev=net0,mac=@MAC@"
QB_ROOTFS_OPT = "-drive id=disk0,file=@ROOTFS@,if=none,format=raw -device virtio-blk-device,drive=disk0"
QB_SERIAL_OPT = "-device virtio-serial-device -chardev null,id=virtcon -device virtconsole,chardev=virtcon"
QB_TCPSERIAL_OPT = " -device virtio-serial-device -chardev socket,id=virtcon,port=@PORT@,host=127.0.0.1 -device virtconsole,chardev=virtcon"
```

## sumo/meta-openembedded/meta-oe/conf/layer.conf
```bitbake
# BK 170430

# We have a conf and classes directory, append to BBPATH
BBPATH .= ":${LAYERDIR}"

# We have a recipes directory, add to BBFILES
BBFILES += "${LAYERDIR}/recipes-*/*/*.bb ${LAYERDIR}/recipes-*/*/*.bbappend"

BBFILE_COLLECTIONS += "oe-sumo"
BBFILE_PATTERN_oe-sumo := "^${LAYERDIR}/"

# Define the priority for recipes (.bb files) from this layer,
# choosing carefully how this layer interacts with all of the
# other layers.
BBFILE_PRIORITY_oe-sumo = "6"

# This should only be incremented on significant changes that will
# cause compatibility issues with other layers
LAYERVERSION_oe-sumo = "1"

LAYERDEPENDS_oe-sumo = "core-sumo"
```

## sumo/meta-openembedded/meta-perl/conf/layer.conf
```bitbake
# We have a conf and classes directory, add to BBPATH
BBPATH .= ":${LAYERDIR}"

# We have recipes-* directories, add to BBFILES
BBFILES += "${LAYERDIR}/recipes-*/*/*.bb \
	${LAYERDIR}/recipes-*/*/*.bbappend"

BBFILE_COLLECTIONS += "perl-sumo"
BBFILE_PATTERN_perl-sumo := "^${LAYERDIR}/"
BBFILE_PRIORITY_perl-sumo = "6"

# This should only be incremented on significant changes that will
# cause compatibility issues with other layers
LAYERVERSION_perl-sumo = "1"

LAYERDEPENDS_perl-sumo = "core-sumo oe-sumo"

# LAYERSERIES_COMPAT_perl-sumo = "sumo"
```

## sumo/meta-openembedded/meta-python/conf/layer.conf
```bitbake
# We might have a conf and classes directory, append to BBPATH
BBPATH .= ":${LAYERDIR}"

# We have recipes directories, add to BBFILES
BBFILES += "${LAYERDIR}/recipes*/*/*.bb ${LAYERDIR}/recipes*/*/*.bbappend"

BBFILE_COLLECTIONS += "python-sumo"
BBFILE_PATTERN_python-sumo := "^${LAYERDIR}/"
BBFILE_PRIORITY_python-sumo = "7"

# This should only be incremented on significant changes that will
# cause compatibility issues with other layers
LAYERVERSION_python-sumo = "1"

LAYERDEPENDS_python-sumo = "core-sumo oe-sumo"

# LAYERSERIES_COMPAT_python-sumo = "sumo"

LICENSE_PATH += "${LAYERDIR}/licenses"
```

## sumo/openembedded-core/meta/conf/layer.conf
```bitbake
# BK 170430

# We have a conf and classes directory, append to BBPATH
BBPATH .= ":${LAYERDIR}"

# We have a recipes directory, add to BBFILES
BBFILES += "${LAYERDIR}/recipes-*/*/*.bb ${LAYERDIR}/recipes-*/*/*.bbappend"

BBFILE_COLLECTIONS += "core-sumo"
BBFILE_PATTERN_core-sumo := "^${LAYERDIR}/"

# Define the priority for recipes (.bb files) from this layer,
# choosing carefully how this layer interacts with all of the
# other layers.
BBFILE_PRIORITY_core-sumo = "6"

# This should only be incremented on significant changes that will
# cause compatibility issues with other layers
LAYERVERSION_core-sumo = "1"

LAYERDEPENDS_core-sumo = "core openembedded-layer"
```
