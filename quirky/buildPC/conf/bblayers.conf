## quirky/buildPi/conf/bblayers.conf
```bitbake
# LAYER_CONF_VERSION is increased each time build/conf/bblayers.conf
# changes incompatibly
LCONF_VERSION = "7"

BBPATH = "${TOPDIR}"
BBFILES ?= ""

BBLAYERS ?= " \
  /mnt/sda2/oe/oe-quirky/meta \
  /mnt/sda2/oe/oe-quirky/meta-oe \
  /mnt/sda2/oe/oe-quirky/meta-python \
  /mnt/sda2/oe/oe-quirky/meta-filesystems \
  /mnt/sda2/oe/oe-quirky/meta-networking \
  /mnt/sda2/oe/oe-quirky/meta-webserver \
  /mnt/sda2/oe/oe-quirky/meta-gnome \
  /mnt/sda2/oe/oe-quirky/meta-multimedia \
  /mnt/sda2/oe/oe-quirky/meta-browser \
  /mnt/sda2/oe/oe-quirky/meta-office \
  /mnt/sda2/oe/oe-quirky/meta-quirky \
  /mnt/sda2/oe/oe-quirky/meta-raspberrypi \
  "
```
