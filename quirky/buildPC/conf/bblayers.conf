## quirky/buildPC/conf/bblayers.conf
```bitbake
# LAYER_CONF_VERSION is increased each time build/conf/bblayers.conf
# changes incompatibly
LCONF_VERSION = "7"

BBPATH = "${TOPDIR}"
BBFILES ?= ""

#  /mnt/sda2/oe/oe-quirky/sumo/meta-openembedded/meta-perl 

BBLAYERS ?= " \
  /mnt/sda2/oe/oe-quirky/meta \
  /mnt/sda2/oe/oe-quirky/meta-oe \
  /mnt/sda2/oe/oe-quirky/sumo/openembedded-core/meta \
  /mnt/sda2/oe/oe-quirky/sumo/meta-openembedded/meta-oe \
  /mnt/sda2/oe/oe-quirky/meta-python \
  /mnt/sda2/oe/oe-quirky/sumo/meta-openembedded/meta-python \
  /mnt/sda2/oe/oe-quirky/meta-perl \
  /mnt/sda2/oe/oe-quirky/meta-filesystems \
  /mnt/sda2/oe/oe-quirky/meta-networking \
  /mnt/sda2/oe/oe-quirky/meta-webserver \
  /mnt/sda2/oe/oe-quirky/meta-gnome \
  /mnt/sda2/oe/oe-quirky/sumo/meta-qt5 \
  /mnt/sda2/oe/oe-quirky/meta-multimedia \
  /mnt/sda2/oe/oe-quirky/sumo/meta-openembedded/meta-multimedia \
  /mnt/sda2/oe/oe-quirky/meta-browser \
  /mnt/sda2/oe/oe-quirky/meta-office \
  /mnt/sda2/oe/oe-quirky/meta-quirky \
  "
```
